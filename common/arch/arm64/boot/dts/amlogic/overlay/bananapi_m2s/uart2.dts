/dts-v1/;
/plugin/;

/ {
	fragment@0 {
		// uart_B driver create ttyS2 on the userspace.
		target = <&uart_B>;

		__overlay__ {
			status = "okay";
			pinctrl-names = "default";
			pinctrl-0 = <&b_uart_pins>; /* GPIOX_6,GPIOX_7 */
		};
	};
};
