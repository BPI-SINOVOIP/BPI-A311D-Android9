/dts-v1/;
/plugin/;

/ {
	fragment@0 {
                // uart_A driver create ttyS1 on the userspace.
		target = <&uart_A>;

		__overlay__ {
			status = "okay";
			pinctrl-names = "default";
			pinctrl-0 = <&a_uart_2_pins>; /* GPIOX_12,GPIOX_13 */
		};
	};
};
