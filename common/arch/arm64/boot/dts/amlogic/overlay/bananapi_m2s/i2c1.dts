/dts-v1/;
/plugin/;

/ {
	fragment@0 {
		target = <&i2c1>;

		__overlay__ {
			status = "okay";
			pinctrl-names = "default";
			pinctrl-0 = <&i2c1_master_pins1>; /* GPIOX_10,GPIOX_11 */
			clock-frequency = <400000>;
		};
	};
};
