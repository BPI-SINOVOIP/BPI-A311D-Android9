/*
 * arch/arm64/boot/dts/amlogic/bananapi_m2s_2g.dts
 *
 * Copyright (C) 2017 Amlogic, Inc. All rights reserved.
 *
 * This program is free software; you can redistribute it and/or modify
 * it under the terms of the GNU General Public License as published by
 * the Free Software Foundation; either version 2 of the License, or
 * (at your option) any later version.
 *
 * This program is distributed in the hope that it will be useful, but WITHOUT
 * ANY WARRANTY; without even the implied warranty of MERCHANTABILITY or
 * FITNESS FOR A PARTICULAR PURPOSE.  See the GNU General Public License for
 * more details.
 *
 */

/dts-v1/;

#include "bananapi_m2s.dts"

/ {
	model = "Amlogic";
	amlogic-dt-id = "bananapi_m2s_2g";
	compatible = "amlogic, g12b";
	interrupt-parent = <&gic>;
	#address-cells = <2>;
	#size-cells = <2>;

	memory@00000000 {
		device_type = "memory";
		linux,usable-memory = <0x0 0x000000 0x0 0x80000000>;
	};
};
